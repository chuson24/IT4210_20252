/* USER CODE BEGIN Header */
/**
  ******************************************************************************
  * File Name          : STM32TouchController.cpp
  ******************************************************************************
  * This file is generated by TouchGFX Generator 4.19.1.
  ******************************************************************************
  * @attention
  *
  * Copyright (c) 2022 STMicroelectronics.
  * All rights reserved.
  *
  * This software is licensed under terms that can be found in the LICENSE file
  * in the root directory of this software component.
  * If no LICENSE file comes with this software, it is provided AS-IS.
  *
  ******************************************************************************
  */
/* USER CODE END Header */

/* USER CODE BEGIN STM32TouchController */
#include <STM32TouchController.hpp>
#include "Components/stmpe811/stmpe811.h"

#define TS_I2C_ADDRESS                      0x82

static TS_DrvTypeDef*     TsDrv;
static uint16_t          TsXBoundary, TsYBoundary;

typedef struct
{
    uint16_t TouchDetected;
    uint16_t X;
    uint16_t Y;
    uint16_t Z;
} TS_StateTypeDef;

typedef enum
{
    TS_OK       = 0x00,
    TS_ERROR    = 0x01,
    TS_TIMEOUT  = 0x02
} TS_StatusTypeDef;

uint8_t BSP_TS_Init(uint16_t XSize, uint16_t YSize);
void    BSP_TS_GetState(TS_StateTypeDef* TsState);

extern "C" uint8_t isRevD; /* Applicable only for STM32F429I DISCOVERY REVD and above */

void STM32TouchController::init()
{
    /**
     * Initialize touch controller and driver
     *
     */
    BSP_TS_Init(240, 320);
}

bool STM32TouchController::sampleTouch(int32_t& x, int32_t& y)
{
    /**
     * By default sampleTouch returns false,
     * return true if a touch has been detected, otherwise false.
     *
     * Coordinates are passed to the caller by reference by x and y.
     *
     * This function is called by the TouchGFX framework.
     * By default sampleTouch is called every tick, this can be adjusted by HAL::setTouchSampleRate(int8_t);
     *
     */
    TS_StateTypeDef state;
    BSP_TS_GetState(&state);
    if (state.TouchDetected)
    {
        x = state.X;
        y = state.Y;
        return true;
    }
    return false;
}

/**
  * @brief  Initializes and configures the touch screen functionalities and
  *         configures all necessary hardware resources (GPIOs, clocks..).
  * @param  XSize: The maximum X size of the TS area on LCD
  * @param  YSize: The maximum Y size of the TS area on LCD
  * @retval TS_OK: if all initializations are OK. Other value if error.
  */
uint8_t BSP_TS_Init(uint16_t XSize, uint16_t YSize)
{
    uint8_t ret = TS_ERROR;

    /* Initialize x and y positions boundaries */
    TsXBoundary = XSize;
    TsYBoundary = YSize;

    /* Read ID and verify if the IO expander is ready */
    if (stmpe811_ts_drv.ReadID(TS_I2C_ADDRESS) == STMPE811_ID)
    {
        /* Initialize the TS driver structure */
        TsDrv = &stmpe811_ts_drv;

        ret = TS_OK;
    }

    if (ret == TS_OK)
    {
        /* Initialize the LL TS Driver */
        TsDrv->Init(TS_I2C_ADDRESS);
        TsDrv->Start(TS_I2C_ADDRESS);
    }

    return ret;
}

/**
  * @brief  Returns status and positions of the touch screen.
  * @param  TsState: Pointer to touch screen current state structure
  *
  * Coordinate calibration notes (STMPE811 ADC raw values → pixel):
  *   The STMPE811 outputs 12-bit ADC values (0–4095) for both axes.
  *   The constants below were empirically derived for the STM32F429I-DISC1 board.
  *   They map the ADC range to the 240×320 LCD pixel area.
  *
  *   Rev D and later boards have a different Y-axis orientation/offset:
  *     Raw Y range: ~180 (top) … ~3700 (bottom) → 3520 counts over 320 pixels
  *     Scale factor: 3520 / 320 ≈ 11 counts/pixel
  *   Older revisions:
  *     Raw Y range: ~360 (top offset) … (360 + 320*11) → same 11 counts/pixel scale
  *
  *   X-axis (both revisions, inverted — ADC decreases as finger moves right):
  *     Raw X ≤ 3000: reference = 3870; Raw X > 3000: reference = 3800
  *     Scale factor: 15 counts/pixel  (240 pixels * 15 = 3600 counts)
  *
  *   Jitter filter: only update the reported position when the Manhattan
  *   distance between the new raw reading and the last accepted position
  *   exceeds 5 counts, suppressing high-frequency noise from the ADC.
  */
void BSP_TS_GetState(TS_StateTypeDef* TsState)
{
    static uint32_t _x = 0, _y = 0;
    static uint8_t  prevTouchDetected = 0;  /* Track previous touch state for edge detection */
    uint16_t xDiff, yDiff, x, y, xr, yr;

    TsState->TouchDetected = TsDrv->DetectTouch(TS_I2C_ADDRESS);

    if (TsState->TouchDetected)
    {
        TsDrv->GetXY(TS_I2C_ADDRESS, &x, &y);

        if (isRevD)
        {
            /* Clamp raw Y to the calibrated active range (180–3700) */
            if (y > 3700)
            {
                y = 3700;
            }
            else if (y < 180)
            {
                y = 180;
            }

            /* Remove bottom offset (raw 180 → pixel 0) */
            y -= 180;

            /* Invert axis: raw 0 is the bottom of screen, subtract from full range */
            y = 3520 - y;   /* 3520 = 3700 - 180 = full calibrated span */
        }
        else
        {
            /* Remove top offset (raw 360 → pixel 0) */
            y -= 360;
        }

        /* Scale raw Y counts to pixels: 11 ADC counts per pixel */
        yr = y / 11;

        /* Clamp to valid pixel range */
        if (yr <= 0)
        {
            yr = 0;
        }
        else if (yr > TsYBoundary)
        {
            yr = TsYBoundary - 1;
        }
        y = yr;

        /* Invert X axis: ADC value decreases as finger moves right.
         * Use slightly different reference for high vs. low raw values
         * to compensate for ADC non-linearity near the edges. */
        if (x <= 3000)
        {
            x = 3870 - x;   /* Reference for left/center region */
        }
        else
        {
            x = 3800 - x;   /* Reference for right region (different linearity) */
        }

        /* Scale raw X counts to pixels: 15 ADC counts per pixel */
        xr = x / 15;

        /* Clamp to valid pixel range */
        if (xr <= 0)
        {
            xr = 0;
        }
        else if (xr > TsXBoundary)
        {
            xr = TsXBoundary - 1;
        }
        x = xr;

        /* On the rising edge of a new touch, skip the jitter filter and accept
         * the position immediately.  Without this, the filter would retain the
         * last position from the previous touch, making the cursor jump to the
         * old location for one tick when a new gesture starts. */
        if (!prevTouchDetected)
        {
            _x = x;
            _y = y;
        }
        else
        {
            /* Jitter filter: only update if Manhattan distance > 5 ADC counts.
             * This suppresses sub-pixel noise from the resistive touch sensor. */
            xDiff = x > _x ? (x - _x) : (_x - x);
            yDiff = y > _y ? (y - _y) : (_y - y);

            if (xDiff + yDiff > 5)
            {
                _x = x;
                _y = y;
            }
        }

        /* Update the X position */
        TsState->X = _x;

        /* Update the Y position */
        TsState->Y = _y;
    }

    prevTouchDetected = TsState->TouchDetected;
}


/* USER CODE END STM32TouchController */

/************************ (C) COPYRIGHT STMicroelectronics *****END OF FILE****/
